## config/boards/shields/totem/Kconfig.defconfig
```kconfig
# Copyright (c) 2022 The ZMK Contributors
# SPDX-License-Identifier: MIT

if SHIELD_t_plus_LEFT

config ZMK_KEYBOARD_NAME
    default "t_plus"
    
config ZMK_SPLIT_ROLE_CENTRAL
    default y

endif

if SHIELD_t_plus_LEFT || SHIELD_t_plus_RIGHT

config ZMK_SPLIT
    default y

endif
```

## config/boards/shields/totem/Kconfig.shield
```kconfig
# Copyright (c) 2022 The ZMK Contributors
# SPDX-License-Identifier: MIT

config SHIELD_t_plus_LEFT
    def_bool $(shields_list_contains,t_plus_left)

config SHIELD_t_plus_RIGHT
    def_bool $(shields_list_contains,t_plus_right)
```
